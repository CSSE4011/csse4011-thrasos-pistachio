## CMakeLists.txt
```
# SPDX-License-Identifier: Apache-2.0

cmake_minimum_required(VERSION 3.20.0)

find_package(Zephyr REQUIRED HINTS $ENV{ZEPHYR_BASE})
project(lvgl)

FILE(GLOB app_sources src/*.c)

FILE(GLOB mylib_sources lib/*.c)

target_include_directories(app PRIVATE include)

target_sources(app PRIVATE ${app_sources} ${mylib_sources})
# target_sources(app PRIVATE ${app_sources})
```

## prj.conf
```kconfig
CONFIG_LV_Z_MEM_POOL_SIZE=16384
CONFIG_LV_Z_SHELL=y
CONFIG_MAIN_STACK_SIZE=4096

CONFIG_DISPLAY=y
CONFIG_DISPLAY_LOG_LEVEL_ERR=y

CONFIG_LOG=y
CONFIG_SHELL=y

CONFIG_LVGL=y
CONFIG_LV_USE_LOG=y
CONFIG_LV_USE_LABEL=y
CONFIG_LV_USE_ARC=y
CONFIG_LV_USE_MONKEY=y
CONFIG_LV_FONT_MONTSERRAT_14=y

CONFIG_BT=y
CONFIG_BT_OBSERVER=y
# CONFIG_BT_SETTINGS=y
# CONFIG_BT_PERIPHERAL=y
CONFIG_ESP32_USE_UNSUPPORTED_REVISION=y


CONFIG_NEWLIB_LIBC=y
CONFIG_NEWLIB_LIBC_FLOAT_PRINTF=y
CONFIG_NEWLIB_LIBC_FLOAT_SCANF=y
```

## src/main.c
```c
#include <zephyr/device.h>
#include <zephyr/devicetree.h>
#include <zephyr/drivers/display.h>
#include <zephyr/drivers/gpio.h>
#include <lvgl.h>
#include <stdio.h>
#include <string.h>
#include <zephyr/kernel.h>
#include <lvgl_input_device.h>
#include "bt.h"
#include "grid.h"
 
#define LOG_LEVEL CONFIG_LOG_DEFAULT_LEVEL
#include <zephyr/logging/log.h>
LOG_MODULE_REGISTER(app);
 
 
int main(void) {
    char coord_str[30] = {0};
    const struct device *display_dev;
    lv_obj_t *coord_label;

    display_dev = DEVICE_DT_GET(DT_CHOSEN(zephyr_display));
    if (!device_is_ready(display_dev)) {
        LOG_ERR("Device not ready, aborting test");
        return 0;
    }
    coord_label = lv_label_create(lv_screen_active());
    lv_obj_align(coord_label, LV_ALIGN_CENTER, 0, 0);

    lv_timer_handler();
    display_blanking_off(display_dev);
     struct pos_data received_coords;

    while (1) {
       if (k_msgq_get(&pos_msgq, &received_coords, K_FOREVER) == 0) {
           // printk("X: %.2f, Y: %.2f", received_coords.x, received_coords.y);

           //can potentially do a fill graph
           
            sprintf(coord_str, "fill: %4.2f, class: %d", received_coords.fill, received_coords.class);
            lv_label_set_text(coord_label, coord_str);
       }

        lv_timer_handler();
       k_sleep(K_MSEC(10));
    }
}
```

## include/bt.h
```c
extern struct k_msgq pos_msgq;

struct pos_data {
    float fill;
    int class;
};
```

## include/grid.h
```c
void update_coordinate_chart(float x, float y);
void create_coordinate_chart(void);
```
