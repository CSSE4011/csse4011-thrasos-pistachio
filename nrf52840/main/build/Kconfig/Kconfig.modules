## nrf52840/main/build/Kconfig/soc/Kconfig
```kconfig
# Load Zephyr SoC Kconfig descriptions.
osource "/Users/emilynilsen/csse4011-thrasos-pistachio/zephyr/soc/xlnx/zynqmp/Kconfig"
osource "/Users/emilynilsen/csse4011-thrasos-pistachio/zephyr/soc/xlnx/zynq7000/Kconfig"
osource "/Users/emilynilsen/csse4011-thrasos-pistachio/zephyr/soc/xlnx/versalnet/Kconfig"
osource "/Users/emilynilsen/csse4011-thrasos-pistachio/zephyr/soc/xen/Kconfig"
osource "/Users/emilynilsen/csse4011-thrasos-pistachio/zephyr/soc/wch/ch32v/Kconfig"
osource "/Users/emilynilsen/csse4011-thrasos-pistachio/zephyr/soc/ti/simplelink/Kconfig"
osource "/Users/emilynilsen/csse4011-thrasos-pistachio/zephyr/soc/ti/lm3s6965/Kconfig"
osource "/Users/emilynilsen/csse4011-thrasos-pistachio/zephyr/soc/ti/k3/Kconfig"
osource "/Users/emilynilsen/csse4011-thrasos-pistachio/zephyr/soc/telink/tlsr/Kconfig"
osource "/Users/emilynilsen/csse4011-thrasos-pistachio/zephyr/soc/starfive/jh71xx/Kconfig"
osource "/Users/emilynilsen/csse4011-thrasos-pistachio/zephyr/soc/st/stm32/Kconfig"
osource "/Users/emilynilsen/csse4011-thrasos-pistachio/zephyr/soc/snps/qemu_arc/Kconfig"
osource "/Users/emilynilsen/csse4011-thrasos-pistachio/zephyr/soc/snps/nsim/arc_v/Kconfig"
osource "/Users/emilynilsen/csse4011-thrasos-pistachio/zephyr/soc/snps/nsim/arc_classic/Kconfig"
osource "/Users/emilynilsen/csse4011-thrasos-pistachio/zephyr/soc/snps/hsdk4xd/Kconfig"
osource "/Users/emilynilsen/csse4011-thrasos-pistachio/zephyr/soc/snps/hsdk/Kconfig"
osource "/Users/emilynilsen/csse4011-thrasos-pistachio/zephyr/soc/snps/emsk/Kconfig"
osource "/Users/emilynilsen/csse4011-thrasos-pistachio/zephyr/soc/snps/emsdp/Kconfig"
osource "/Users/emilynilsen/csse4011-thrasos-pistachio/zephyr/soc/snps/arc_iot/Kconfig"
osource "/Users/emilynilsen/csse4011-thrasos-pistachio/zephyr/soc/silabs/Kconfig"
osource "/Users/emilynilsen/csse4011-thrasos-pistachio/zephyr/soc/sifive/sifive_freedom/Kconfig"
osource "/Users/emilynilsen/csse4011-thrasos-pistachio/zephyr/soc/sensry/Kconfig"
osource "/Users/emilynilsen/csse4011-thrasos-pistachio/zephyr/soc/rockchip/Kconfig"
osource "/Users/emilynilsen/csse4011-thrasos-pistachio/zephyr/soc/renode/riscv_virtual/Kconfig"
osource "/Users/emilynilsen/csse4011-thrasos-pistachio/zephyr/soc/renode/cortex_r8_virtual/Kconfig"
osource "/Users/emilynilsen/csse4011-thrasos-pistachio/zephyr/soc/renesas/smartbond/Kconfig"
osource "/Users/emilynilsen/csse4011-thrasos-pistachio/zephyr/soc/renesas/rz/Kconfig"
osource "/Users/emilynilsen/csse4011-thrasos-pistachio/zephyr/soc/renesas/rx/Kconfig"
osource "/Users/emilynilsen/csse4011-thrasos-pistachio/zephyr/soc/renesas/rcar/Kconfig"
osource "/Users/emilynilsen/csse4011-thrasos-pistachio/zephyr/soc/renesas/ra/Kconfig"
osource "/Users/emilynilsen/csse4011-thrasos-pistachio/zephyr/soc/realtek/ec/Kconfig"
osource "/Users/emilynilsen/csse4011-thrasos-pistachio/zephyr/soc/raspberrypi/rpi_pico/Kconfig"
osource "/Users/emilynilsen/csse4011-thrasos-pistachio/zephyr/soc/quicklogic/eos_s3/Kconfig"
osource "/Users/emilynilsen/csse4011-thrasos-pistachio/zephyr/soc/qemu/virt_riscv/Kconfig"
osource "/Users/emilynilsen/csse4011-thrasos-pistachio/zephyr/soc/qemu/malta/Kconfig"
osource "/Users/emilynilsen/csse4011-thrasos-pistachio/zephyr/soc/openisa/rv32m1/Kconfig"
osource "/Users/emilynilsen/csse4011-thrasos-pistachio/zephyr/soc/openhwgroup/cva6/Kconfig"
osource "/Users/emilynilsen/csse4011-thrasos-pistachio/zephyr/soc/oct/osd32mp15x/Kconfig"
osource "/Users/emilynilsen/csse4011-thrasos-pistachio/zephyr/soc/nxp/s32/Kconfig"
osource "/Users/emilynilsen/csse4011-thrasos-pistachio/zephyr/soc/nxp/rw/Kconfig"
osource "/Users/emilynilsen/csse4011-thrasos-pistachio/zephyr/soc/nxp/mcx/Kconfig"
osource "/Users/emilynilsen/csse4011-thrasos-pistachio/zephyr/soc/nxp/lpc/Kconfig"
osource "/Users/emilynilsen/csse4011-thrasos-pistachio/zephyr/soc/nxp/layerscape/Kconfig"
osource "/Users/emilynilsen/csse4011-thrasos-pistachio/zephyr/soc/nxp/kinetis/Kconfig"
osource "/Users/emilynilsen/csse4011-thrasos-pistachio/zephyr/soc/nxp/imxrt/Kconfig"
osource "/Users/emilynilsen/csse4011-thrasos-pistachio/zephyr/soc/nxp/imx/Kconfig"
osource "/Users/emilynilsen/csse4011-thrasos-pistachio/zephyr/soc/nuvoton/numicro/Kconfig"
osource "/Users/emilynilsen/csse4011-thrasos-pistachio/zephyr/soc/nuvoton/numaker/Kconfig"
osource "/Users/emilynilsen/csse4011-thrasos-pistachio/zephyr/soc/nuvoton/npcx/Kconfig"
osource "/Users/emilynilsen/csse4011-thrasos-pistachio/zephyr/soc/nuvoton/npcm/Kconfig"
osource "/Users/emilynilsen/csse4011-thrasos-pistachio/zephyr/soc/nordic/Kconfig"
osource "/Users/emilynilsen/csse4011-thrasos-pistachio/zephyr/soc/neorv32/Kconfig"
osource "/Users/emilynilsen/csse4011-thrasos-pistachio/zephyr/soc/native/inf_clock/Kconfig"
osource "/Users/emilynilsen/csse4011-thrasos-pistachio/zephyr/soc/microchip/miv/Kconfig"
osource "/Users/emilynilsen/csse4011-thrasos-pistachio/zephyr/soc/microchip/mec/Kconfig"
osource "/Users/emilynilsen/csse4011-thrasos-pistachio/zephyr/soc/mediatek/mt8xxx/Kconfig"
osource "/Users/emilynilsen/csse4011-thrasos-pistachio/zephyr/soc/lowrisc/opentitan/Kconfig"
osource "/Users/emilynilsen/csse4011-thrasos-pistachio/zephyr/soc/litex/litex_vexriscv/Kconfig"
osource "/Users/emilynilsen/csse4011-thrasos-pistachio/zephyr/soc/ite/ec/Kconfig"
osource "/Users/emilynilsen/csse4011-thrasos-pistachio/zephyr/soc/intel/raptor_lake/Kconfig"
osource "/Users/emilynilsen/csse4011-thrasos-pistachio/zephyr/soc/intel/lakemont/Kconfig"
osource "/Users/emilynilsen/csse4011-thrasos-pistachio/zephyr/soc/intel/intel_socfpga_std/Kconfig"
osource "/Users/emilynilsen/csse4011-thrasos-pistachio/zephyr/soc/intel/intel_socfpga/Kconfig"
osource "/Users/emilynilsen/csse4011-thrasos-pistachio/zephyr/soc/intel/intel_niosv/Kconfig"
osource "/Users/emilynilsen/csse4011-thrasos-pistachio/zephyr/soc/intel/intel_ish/Kconfig"
osource "/Users/emilynilsen/csse4011-thrasos-pistachio/zephyr/soc/intel/intel_adsp/Kconfig"
osource "/Users/emilynilsen/csse4011-thrasos-pistachio/zephyr/soc/intel/elkhart_lake/Kconfig"
osource "/Users/emilynilsen/csse4011-thrasos-pistachio/zephyr/soc/intel/atom/Kconfig"
osource "/Users/emilynilsen/csse4011-thrasos-pistachio/zephyr/soc/intel/apollo_lake/Kconfig"
osource "/Users/emilynilsen/csse4011-thrasos-pistachio/zephyr/soc/intel/alder_lake/Kconfig"
osource "/Users/emilynilsen/csse4011-thrasos-pistachio/zephyr/soc/infineon/cat3/Kconfig"
osource "/Users/emilynilsen/csse4011-thrasos-pistachio/zephyr/soc/infineon/cat1b/Kconfig"
osource "/Users/emilynilsen/csse4011-thrasos-pistachio/zephyr/soc/infineon/cat1a/Kconfig"
osource "/Users/emilynilsen/csse4011-thrasos-pistachio/zephyr/soc/gd/gd32/Kconfig"
osource "/Users/emilynilsen/csse4011-thrasos-pistachio/zephyr/soc/gaisler/leon3/Kconfig"
osource "/Users/emilynilsen/csse4011-thrasos-pistachio/zephyr/soc/gaisler/gr716a/Kconfig"
osource "/Users/emilynilsen/csse4011-thrasos-pistachio/zephyr/soc/espressif/Kconfig"
osource "/Users/emilynilsen/csse4011-thrasos-pistachio/zephyr/soc/ene/kb1200/Kconfig"
osource "/Users/emilynilsen/csse4011-thrasos-pistachio/zephyr/soc/efinix/sapphire/Kconfig"
osource "/Users/emilynilsen/csse4011-thrasos-pistachio/zephyr/soc/cdns/xtensa_sample_controller/Kconfig"
osource "/Users/emilynilsen/csse4011-thrasos-pistachio/zephyr/soc/cdns/sample_controller32/Kconfig"
osource "/Users/emilynilsen/csse4011-thrasos-pistachio/zephyr/soc/cdns/dc233c/Kconfig"
osource "/Users/emilynilsen/csse4011-thrasos-pistachio/zephyr/soc/brcm/bcmvk/Kconfig"
osource "/Users/emilynilsen/csse4011-thrasos-pistachio/zephyr/soc/brcm/bcm2712/Kconfig"
osource "/Users/emilynilsen/csse4011-thrasos-pistachio/zephyr/soc/brcm/bcm2711/Kconfig"
osource "/Users/emilynilsen/csse4011-thrasos-pistachio/zephyr/soc/bflb/Kconfig"
osource "/Users/emilynilsen/csse4011-thrasos-pistachio/zephyr/soc/atmel/sam0/Kconfig"
osource "/Users/emilynilsen/csse4011-thrasos-pistachio/zephyr/soc/atmel/sam/Kconfig"
osource "/Users/emilynilsen/csse4011-thrasos-pistachio/zephyr/soc/aspeed/Kconfig"
osource "/Users/emilynilsen/csse4011-thrasos-pistachio/zephyr/soc/arm/Kconfig"
osource "/Users/emilynilsen/csse4011-thrasos-pistachio/zephyr/soc/arm/beetle/Kconfig"
osource "/Users/emilynilsen/csse4011-thrasos-pistachio/zephyr/soc/antmicro/myra/Kconfig"
osource "/Users/emilynilsen/csse4011-thrasos-pistachio/zephyr/soc/andestech/Kconfig"
osource "/Users/emilynilsen/csse4011-thrasos-pistachio/zephyr/soc/amd/acp_6_0/Kconfig"
osource "/Users/emilynilsen/csse4011-thrasos-pistachio/zephyr/soc/ambiq/Kconfig"
osource "/Users/emilynilsen/csse4011-thrasos-pistachio/zephyr/soc/altr/zephyr_nios2f/Kconfig"
osource "/Users/emilynilsen/csse4011-thrasos-pistachio/zephyr/soc/altr/qemu_nios2/Kconfig"
osource "/Users/emilynilsen/csse4011-thrasos-pistachio/zephyr/soc/adi/max32/Kconfig"
```

## thingy52/prac2/build/Kconfig/boards/Kconfig.defconfig
```kconfig
# Load Zephyr board defconfig descriptions.
osource "/Users/wendi/csse4011/repo/zephyr/boards/nordic/thingy52/Kconfig.defconfig"
```

## thingy52/prac2/build/Kconfig/boards/Kconfig.sysbuild
```kconfig
# Load Sysbuild board Kconfig descriptions.
osource "/Users/wendi/csse4011/repo/zephyr/boards/nordic/thingy52/Kconfig.sysbuild"
```

## thingy52/prac2/build/Kconfig/soc/Kconfig
```kconfig
# Load Zephyr SoC Kconfig descriptions.
osource "/Users/wendi/csse4011/repo/zephyr/soc/xlnx/zynqmp/Kconfig"
osource "/Users/wendi/csse4011/repo/zephyr/soc/xlnx/zynq7000/Kconfig"
osource "/Users/wendi/csse4011/repo/zephyr/soc/xen/Kconfig"
osource "/Users/wendi/csse4011/repo/zephyr/soc/wch/ch32v/Kconfig"
osource "/Users/wendi/csse4011/repo/zephyr/soc/ti/simplelink/Kconfig"
osource "/Users/wendi/csse4011/repo/zephyr/soc/ti/lm3s6965/Kconfig"
osource "/Users/wendi/csse4011/repo/zephyr/soc/ti/k3/Kconfig"
osource "/Users/wendi/csse4011/repo/zephyr/soc/telink/tlsr/Kconfig"
osource "/Users/wendi/csse4011/repo/zephyr/soc/starfive/jh71xx/Kconfig"
osource "/Users/wendi/csse4011/repo/zephyr/soc/st/stm32/Kconfig"
osource "/Users/wendi/csse4011/repo/zephyr/soc/snps/qemu_arc/Kconfig"
osource "/Users/wendi/csse4011/repo/zephyr/soc/snps/nsim/arc_v/Kconfig"
osource "/Users/wendi/csse4011/repo/zephyr/soc/snps/nsim/arc_classic/Kconfig"
osource "/Users/wendi/csse4011/repo/zephyr/soc/snps/hsdk4xd/Kconfig"
osource "/Users/wendi/csse4011/repo/zephyr/soc/snps/hsdk/Kconfig"
osource "/Users/wendi/csse4011/repo/zephyr/soc/snps/emsk/Kconfig"
osource "/Users/wendi/csse4011/repo/zephyr/soc/snps/emsdp/Kconfig"
osource "/Users/wendi/csse4011/repo/zephyr/soc/snps/arc_iot/Kconfig"
osource "/Users/wendi/csse4011/repo/zephyr/soc/silabs/Kconfig"
osource "/Users/wendi/csse4011/repo/zephyr/soc/sifive/sifive_freedom/Kconfig"
osource "/Users/wendi/csse4011/repo/zephyr/soc/sensry/Kconfig"
osource "/Users/wendi/csse4011/repo/zephyr/soc/rockchip/Kconfig"
osource "/Users/wendi/csse4011/repo/zephyr/soc/renode/riscv_virtual/Kconfig"
osource "/Users/wendi/csse4011/repo/zephyr/soc/renode/cortex_r8_virtual/Kconfig"
osource "/Users/wendi/csse4011/repo/zephyr/soc/renesas/smartbond/Kconfig"
osource "/Users/wendi/csse4011/repo/zephyr/soc/renesas/rzt2m/Kconfig"
osource "/Users/wendi/csse4011/repo/zephyr/soc/renesas/rz/Kconfig"
osource "/Users/wendi/csse4011/repo/zephyr/soc/renesas/rcar/Kconfig"
osource "/Users/wendi/csse4011/repo/zephyr/soc/renesas/ra/Kconfig"
osource "/Users/wendi/csse4011/repo/zephyr/soc/realtek/ec/Kconfig"
osource "/Users/wendi/csse4011/repo/zephyr/soc/raspberrypi/rpi_pico/Kconfig"
osource "/Users/wendi/csse4011/repo/zephyr/soc/quicklogic/eos_s3/Kconfig"
osource "/Users/wendi/csse4011/repo/zephyr/soc/qemu/virt_riscv/Kconfig"
osource "/Users/wendi/csse4011/repo/zephyr/soc/qemu/malta/Kconfig"
osource "/Users/wendi/csse4011/repo/zephyr/soc/openisa/rv32m1/Kconfig"
osource "/Users/wendi/csse4011/repo/zephyr/soc/nxp/s32/Kconfig"
osource "/Users/wendi/csse4011/repo/zephyr/soc/nxp/rw/Kconfig"
osource "/Users/wendi/csse4011/repo/zephyr/soc/nxp/mcx/Kconfig"
osource "/Users/wendi/csse4011/repo/zephyr/soc/nxp/lpc/Kconfig"
osource "/Users/wendi/csse4011/repo/zephyr/soc/nxp/layerscape/Kconfig"
osource "/Users/wendi/csse4011/repo/zephyr/soc/nxp/kinetis/Kconfig"
osource "/Users/wendi/csse4011/repo/zephyr/soc/nxp/imxrt/Kconfig"
osource "/Users/wendi/csse4011/repo/zephyr/soc/nxp/imx/Kconfig"
osource "/Users/wendi/csse4011/repo/zephyr/soc/nuvoton/numicro/Kconfig"
osource "/Users/wendi/csse4011/repo/zephyr/soc/nuvoton/numaker/Kconfig"
osource "/Users/wendi/csse4011/repo/zephyr/soc/nuvoton/npcx/Kconfig"
osource "/Users/wendi/csse4011/repo/zephyr/soc/nuvoton/npcm/Kconfig"
osource "/Users/wendi/csse4011/repo/zephyr/soc/nordic/Kconfig"
osource "/Users/wendi/csse4011/repo/zephyr/soc/neorv32/Kconfig"
osource "/Users/wendi/csse4011/repo/zephyr/soc/native/inf_clock/Kconfig"
osource "/Users/wendi/csse4011/repo/zephyr/soc/microchip/miv/Kconfig"
osource "/Users/wendi/csse4011/repo/zephyr/soc/microchip/mec/Kconfig"
osource "/Users/wendi/csse4011/repo/zephyr/soc/mediatek/mt8xxx/Kconfig"
osource "/Users/wendi/csse4011/repo/zephyr/soc/lowrisc/opentitan/Kconfig"
osource "/Users/wendi/csse4011/repo/zephyr/soc/litex/litex_vexriscv/Kconfig"
osource "/Users/wendi/csse4011/repo/zephyr/soc/ite/ec/Kconfig"
osource "/Users/wendi/csse4011/repo/zephyr/soc/intel/raptor_lake/Kconfig"
osource "/Users/wendi/csse4011/repo/zephyr/soc/intel/lakemont/Kconfig"
osource "/Users/wendi/csse4011/repo/zephyr/soc/intel/intel_socfpga_std/Kconfig"
osource "/Users/wendi/csse4011/repo/zephyr/soc/intel/intel_socfpga/Kconfig"
osource "/Users/wendi/csse4011/repo/zephyr/soc/intel/intel_niosv/Kconfig"
osource "/Users/wendi/csse4011/repo/zephyr/soc/intel/intel_ish/Kconfig"
osource "/Users/wendi/csse4011/repo/zephyr/soc/intel/intel_adsp/Kconfig"
osource "/Users/wendi/csse4011/repo/zephyr/soc/intel/elkhart_lake/Kconfig"
osource "/Users/wendi/csse4011/repo/zephyr/soc/intel/atom/Kconfig"
osource "/Users/wendi/csse4011/repo/zephyr/soc/intel/apollo_lake/Kconfig"
osource "/Users/wendi/csse4011/repo/zephyr/soc/intel/alder_lake/Kconfig"
osource "/Users/wendi/csse4011/repo/zephyr/soc/infineon/cat3/Kconfig"
osource "/Users/wendi/csse4011/repo/zephyr/soc/infineon/cat1b/Kconfig"
osource "/Users/wendi/csse4011/repo/zephyr/soc/infineon/cat1a/Kconfig"
osource "/Users/wendi/csse4011/repo/zephyr/soc/gd/gd32/Kconfig"
osource "/Users/wendi/csse4011/repo/zephyr/soc/gaisler/leon3/Kconfig"
osource "/Users/wendi/csse4011/repo/zephyr/soc/gaisler/gr716a/Kconfig"
osource "/Users/wendi/csse4011/repo/zephyr/soc/espressif/Kconfig"
osource "/Users/wendi/csse4011/repo/zephyr/soc/ene/kb1200/Kconfig"
osource "/Users/wendi/csse4011/repo/zephyr/soc/efinix/sapphire/Kconfig"
osource "/Users/wendi/csse4011/repo/zephyr/soc/cdns/xtensa_sample_controller/Kconfig"
osource "/Users/wendi/csse4011/repo/zephyr/soc/cdns/sample_controller32/Kconfig"
osource "/Users/wendi/csse4011/repo/zephyr/soc/cdns/dc233c/Kconfig"
osource "/Users/wendi/csse4011/repo/zephyr/soc/brcm/bcmvk/Kconfig"
osource "/Users/wendi/csse4011/repo/zephyr/soc/brcm/bcm2712/Kconfig"
osource "/Users/wendi/csse4011/repo/zephyr/soc/brcm/bcm2711/Kconfig"
osource "/Users/wendi/csse4011/repo/zephyr/soc/atmel/sam0/Kconfig"
osource "/Users/wendi/csse4011/repo/zephyr/soc/atmel/sam/Kconfig"
osource "/Users/wendi/csse4011/repo/zephyr/soc/aspeed/Kconfig"
osource "/Users/wendi/csse4011/repo/zephyr/soc/arm/Kconfig"
osource "/Users/wendi/csse4011/repo/zephyr/soc/arm/beetle/Kconfig"
osource "/Users/wendi/csse4011/repo/zephyr/soc/antmicro/myra/Kconfig"
osource "/Users/wendi/csse4011/repo/zephyr/soc/andestech/Kconfig"
osource "/Users/wendi/csse4011/repo/zephyr/soc/amd/acp_6_0/Kconfig"
osource "/Users/wendi/csse4011/repo/zephyr/soc/ambiq/Kconfig"
osource "/Users/wendi/csse4011/repo/zephyr/soc/altr/zephyr_nios2f/Kconfig"
osource "/Users/wendi/csse4011/repo/zephyr/soc/altr/qemu_nios2/Kconfig"
osource "/Users/wendi/csse4011/repo/zephyr/soc/adi/max32/Kconfig"
```
