## CMakeLists.txt
```
cmake_minimum_required(VERSION 3.20.0)
find_package(Zephyr REQUIRED HINTS $ENV{ZEPHYR_BASE})
project(prac2)

# Collect all the source files in app/prac2/src
FILE(GLOB app_sources src/main.c)

# Collect all the source files in lib. Note that
# the path given needs to be relative to the
# CMakeLists root, which is app/prac2 here,
# hence the ../../lib.c.
FILE(GLOB lib_sources ../lib/*.c)

set(RTT_SOURCES ../modules/hal/nxp//mcux/mcux-sdk/components/rtt/RTT/SEGGER_RTT_printf.c)

# Tell CMake to build with the app and lib sources
target_sources(app PRIVATE ${app_sources} ${lib_sources} ${RTT_SOURCES})

# Tell CMake where our header files are
target_include_directories(app PRIVATE ../include)
```

## sample.yaml
```
sample:
  name: Prac 1
tests:
  sample.basic.prac1:
    tags:
      - gpio
      - rng
    depends_on: gpio
    harness: gpio
    integration_platforms:
      - frdm_k64f
```

## prj.conf
```kconfig
CONFIG_GPIO=y

#rtc things
CONFIG_RTC=y
CONFIG_COUNTER=y
CONFIG_NRF_RTC_TIMER=y

#sensors things
CONFIG_STDOUT_CONSOLE=y
CONFIG_I2C=y
CONFIG_SENSOR=y
CONFIG_HTS221=y
CONFIG_HTS221_TRIGGER_NONE=y
CONFIG_CCS811=y
CONFIG_LPS22HB=y
CONFIG_RING_BUFFER=y

#shell things 
CONFIG_PRINTK=y
CONFIG_SHELL=y
CONFIG_SHELL_MINIMAL=y
CONFIG_SHELL_STACK_SIZE=1024
CONFIG_SHELL_BACKEND_SERIAL=n

CONFIG_THREAD_MONITOR=y
CONFIG_INIT_STACKS=y
CONFIG_BOOT_BANNER=n
CONFIG_THREAD_NAME=y
CONFIG_LOG=n
CONFIG_CONSOLE=y
CONFIG_CBPRINTF_NANO=y

#enable RTT shell
CONFIG_USE_SEGGER_RTT=y
CONFIG_SHELL_BACKEND_RTT=y
CONFIG_RTT_CONSOLE=y
CONFIG_UART_CONSOLE=n
CONFIG_SHELL_BACKEND_RTT_BUFFER=1

#json things
CONFIG_JSON_LIBRARY=y
CONFIG_THREAD_MONITOR=y
CONFIG_THREAD_STACK_INFO=y
CONFIG_THREAD_RUNTIME_STATS=y

#LEDs
CONFIG_LED=y

CONFIG_DYNAMIC_OBJECTS=y
CONFIG_HEAP_MEM_POOL_SIZE=2048
```

## boards/thingy52_nrf52832.overlay
```dts
/ {
	soc {
		rtc2: rtc@40024000{
			status = "okay";
		};
	};
};
```

## src/main.c
```c
#include <zephyr/kernel.h>
#include <zephyr/device.h>
#include <zephyr/drivers/rtc.h>
#include <zephyr/drivers/sensor.h>
#include <zephyr/drivers/gpio.h>
#include <zephyr/drivers/counter.h>
#include <zephyr/sys/util.h>
#include <zephyr/shell/shell.h>
#include <SEGGER_RTT.h>
#include <zephyr/drivers/i2c.h>
#include <zephyr/drivers/sensor/ccs811.h>
#include <stdio.h>
#include <zephyr/sys/ring_buffer.h>
#include <zephyr/shell/shell_uart.h>
#include <zephyr/sys/printk.h>
#include <zephyr/logging/log.h>
#include <zephyr/data/json.h>
#include <zephyr/drivers/led.h>
#include "rtc.h"
#include "thingy.h"
#include "button.h"
#include "led.h"


int cmd_sensor(const struct shell *shell, size_t argc, char **argv) {
	int did = atoi(argv[1]);
	sensor_data_t received_data;

	k_mutex_lock(&sensor_mutex, K_FOREVER);
    received_data = get_sensor_data(did);
    k_mutex_unlock(&sensor_mutex);

	if (did == 3) {
		printk ("DID: %d, data: %d, %d\n", did, received_data.sensor.val1, received_data.sensor.val2);
	} else {
		printk ("DID: %d, data: %d.%2d\n", did, received_data.sensor.val1, received_data.sensor.val2);
	}
	
	return 0;
}

int main(void) {

	rtc_init();

	date_time_t initial_time = {
        .year = 2025,
        .month = 4,
        .day = 3,
        .hour = 11,
        .minute = 30,
        .second = 0
    };
    set_date_time(&initial_time);
	
	SEGGER_RTT_Init();

	printk("started!");

	k_mutex_init(&sensor_mutex);
	button_init();
	led_init();
	set_colour(0);
	
	SHELL_CMD_ARG_REGISTER(rtc, NULL, "rtc", cmd_rtc, 2, 4);

    SHELL_CMD_ARG_REGISTER(sensor, NULL, "sensor info", cmd_sensor, 2, 2);

	SHELL_CMD_ARG_REGISTER(sample, NULL, "sample", cmd_sample, 2, 3);

    return 0;
}
```
